## CMakeLists.txt
```
cmake_minimum_required(VERSION 3.20.0)

find_package(Zephyr REQUIRED HINTS $ENV{ZEPHYR_BASE})
project(emlearn_hello_world)

include_directories(../../src/experiments/ ../code)
add_definitions(-DMODEL_M2CGEN)

file(GLOB app_sources src/*)
target_sources(app PRIVATE ${app_sources})
```

## west.yml
```
# Copyright (c) 2021 Nordic Semiconductor ASA
# SPDX-License-Identifier: Apache-2.0

manifest:
  remotes:
    - name: zephyrproject-rtos
      url-base: https://github.com/zephyrproject-rtos

  projects:
    - name: zephyr
      remote: zephyrproject-rtos
      revision: v3.5.0
      import:
        # By using name-allowlist we can clone only the modules that are strictly needed
        name-allowlist:
          - cmsis      # required by the ARM port
          - hal_nordic # required by the qemu cortex board (Nordic based)
          - hal_rpi_pico

    - name: emlearn
      url: https://github.com/emlearn/emlearn
      revision: master
```

## prj.conf
```kconfig
# enable the emlearn module
CONFIG_EMLEARN=y

# micromlgen uses C++
#CONFIG_CPP=y

# Enable USB serial console
CONFIG_USB_DEVICE_STACK=y
CONFIG_USB_DEVICE_PRODUCT="RPi Pico USB Serial Console"
CONFIG_USB_DEVICE_VID=0001
CONFIG_SERIAL=y
CONFIG_CONSOLE=y
CONFIG_UART_CONSOLE=y
CONFIG_UART_LINE_CTRL=y

# Try fix crash
CONFIG_MAIN_STACK_SIZE=8192
CONFIG_SYSTEM_WORKQUEUE_STACK_SIZE=8192
CONFIG_IDLE_STACK_SIZE=8192
CONFIG_ISR_STACK_SIZE=8192

# Debug
CONFIG_DEBUG_THREAD_INFO=y
CONFIG_LOG=y
CONFIG_EXTRA_EXCEPTION_INFO=y
#CONFIG_RESET_ON_FATAL_ERROR=n
```

## src/main.c
```c
//#if defined(MODEL_MICROMLGEN)
//#else
#include "runtests.c"
//#endif

#include <zephyr/kernel.h>
#include <zephyr/sys/printk.h>
#include <zephyr/sys/util.h>
#include <string.h>
#include <zephyr/usb/usb_device.h>
#include <zephyr/drivers/uart.h>

/* Check overlay exists for CDC UART console */ 
BUILD_ASSERT(DT_NODE_HAS_COMPAT(DT_CHOSEN(zephyr_console), zephyr_cdc_acm_uart),
	    "Console device is not ACM CDC UART device");

int main(void)
{
	/* Configure to set Console output to USB Serial */ 
	const struct device *usb_device = DEVICE_DT_GET(DT_CHOSEN(zephyr_console));
	uint32_t dtr = 0;

    /* Check if USB can be initialised, bails out if fail is returned */
	if (usb_enable(NULL) != 0) {
		return 1;
	}

	/* Wait for a console connection, if the DTR flag was set to activate USB */
	while (!dtr) {
		uart_line_ctrl_get(usb_device, UART_LINE_CTRL_DTR, &dtr);
		k_sleep(K_MSEC(100));
	}

	while (1) {

        run_tests();
		k_sleep(K_MSEC(1000));
	}
    
    return 0;
}
```

## src/tests.cpp
```c
#if 0
#if defined(MODEL_MICROMLGEN)
#include "runtests.c"
#endif
#endif
```
